## components/xfer_http/Kconfig
```kconfig
menu "Pengaturan Transfer HTTP"
    config ESP_WIFI_SSID
        string "SSID WiFi STA"
        default ""

    config ESP_WIFI_PASSWORD
        string "Kata sandi WiFi STA"
        default ""

    config ESP_MAXIMUM_RETRY
        int "Maksimum percobaan ulang"
        default 5

    config ANALYZE_EGG_ENDPOINT
        string "Endpoint API Analisis Telur"
        default "http://192.168.1.22:8000/analyze-egg"

    config MANUAL_HTTP_SERVER_PORT
        int "Port server HTTP mode manual"
        range 1 65535
        default 80
endmenu
```

## main/Kconfig.projbuild
```kconfig
menu "Example Configuration"
    config ESP32_S3_USB_OTG
        bool "ESP32 S3 USB OTG"
        default y
        depends on IDF_TARGET_ESP32S3
endmenu
```

## sdkconfig.defaults
```kconfig
CONFIG_PARTITION_TABLE_SINGLE_APP_LARGE=y
CONFIG_ESP32_S3_USB_OTG=y
CONFIG_ESP_WIFI_ENABLED=y
CONFIG_ESPTOOLPY_FLASHSIZE_16MB=y
CONFIG_ESPTOOLPY_FLASHSIZE="16MB"
CONFIG_USB_HOST_CONTROL_TRANSFER_MAX_SIZE=2048
CONFIG_CTRL_TRANSFER_DATA_MAX_BYTES=2048
CONFIG_USB_HOST_HW_BUFFER_BIAS_IN=y
CONFIG_ESP_WIFI_SSID="Nokia123"
CONFIG_ESP_WIFI_PASSWORD="12345678"
CONFIG_ANALYZE_EGG_ENDPOINT="https:///analyze-egg"
CONFIG_HTTPD_MAX_REQ_HDR_LEN=4096
CONFIG_HTTPD_MAX_URI_LEN=2048
CONFIG_MANUAL_HTTP_SERVER_PORT=8001
CONFIG_ESP_WIFI_DYNAMIC_RX_BUFFER_NUM=16
CONFIG_ESP_WIFI_DYNAMIC_TX_BUFFER_NUM=16
CONFIG_SPIRAM=y
CONFIG_SPIRAM_MODE_OCT=y
CONFIG_SPIRAM_SPEED_80M=y
CONFIG_SPIRAM_USE_MALLOC=y
CONFIG_SPIRAM_MALLOC_ALWAYSINTERNAL=16384
```
